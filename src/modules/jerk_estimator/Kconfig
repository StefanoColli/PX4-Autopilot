## src/modules/jerk_estimator/Kconfig
```kconfig
menuconfig MODULES_JERK_ESTIMATOR
	bool "jerk_estimator"
	default n
	---help---
		Enable support for jerk estimator which creates the input vector for the quadricopter linearizer
```

## src/modules/linearizer/Kconfig
```kconfig
menuconfig MODULES_LINEARIZER
	bool "linearizer"
	depends on MODULES_JERK_ESTIMATOR
	default n
	---help---
		Enable support for quadcopter linearizer
```
